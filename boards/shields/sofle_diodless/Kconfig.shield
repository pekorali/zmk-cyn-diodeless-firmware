## boards/shields/sofle_diodless/Kconfig.shield
```kconfig
# Copyright (c) 2026, sofle_diodless contributors
# SPDX-License-Identifier: MIT

config SHIELD_SOFLE_DIODLESS_LEFT
    def_bool $(shields_list_contains,sofle_diodless_left)

config SHIELD_SOFLE_DIODLESS_RIGHT
    def_bool $(shields_list_contains,sofle_diodless_right)
```

## dts/bindings/kscan/zmk,kscan-gpio-matrix-hiz.yaml
```yaml
#
# Copyright (c) 2026, sofle_diodless contributors
# SPDX-License-Identifier: MIT
#

description: |
  GPIO keyboard matrix controller for DIODELESS matrices.

  Unlike the standard zmk,kscan-gpio-matrix driver, this driver puts the
  outputs that are not currently being scanned into a high-impedance state
  instead of driving them to the inactive level.

  In a matrix without diodes, two keys that share a node (a row or a column)
  short two outputs of the MCU against each other. The standard driver drives
  the idle outputs to a defined level, so the short happens and both keys read
  as released. With the idle outputs in high-Z, no short is possible and the
  matrix behaves like a proper NKRO matrix: any combination of keys can be
  pressed at the same time.

compatible: "zmk,kscan-gpio-matrix-hiz"

properties:
  row-gpios:
    type: phandle-array
    required: true
    description: |
      The row GPIOs. Always the OUTPUTS: exactly one of them is driven to its
      active level at a time, the rest are left in high-Z (floating input).
      They are driven to their active level (LOW with GPIO_ACTIVE_LOW) in the
      idle state so a key press can raise the level interrupt.
  col-gpios:
    type: phandle-array
    required: true
    description: |
      The column GPIOs. Always the INPUTS; each one needs a pull-up
      (GPIO_PULL_UP) in the devicetree. A pressed key pulls its column to the
      level driven by the row that is currently being scanned.
  debounce-press-ms:
    type: int
    default: 5
    description: Debounce time for key press in milliseconds. Use 0 for eager debouncing.
  debounce-release-ms:
    type: int
    default: 5
    description: Debounce time for key release in milliseconds.
  debounce-scan-period-ms:
    type: int
    default: 1
    description: Time between reads in milliseconds when any key is pressed.
  poll-period-ms:
    type: int
    default: 10
    description: Time between reads in milliseconds when no key is pressed.
```

## zephyr/Kconfig
```kconfig
# Copyright (c) 2026, sofle_diodless contributors
# SPDX-License-Identifier: MIT

DT_COMPAT_ZMK_KSCAN_GPIO_MATRIX_HIZ := zmk,kscan-gpio-matrix-hiz

config ZMK_KSCAN_GPIO_MATRIX_HIZ
	bool
	default $(dt_compat_enabled,$(DT_COMPAT_ZMK_KSCAN_GPIO_MATRIX_HIZ))
	select GPIO
	select ZMK_KSCAN_GPIO_DRIVER
	help
	  GPIO matrix scanner for diodeless matrices. Unlike the stock
	  zmk,kscan-gpio-matrix driver, the outputs that are not being scanned
	  are put into a high-impedance state instead of being driven to the
	  inactive level, which removes the key ghosting of diodeless matrices
	  and gives full NKRO.

config ZMK_KSCAN_GPIO_MATRIX_HIZ_GHOST_FILTER
	bool "Filter out ghost keys of a diodeless matrix"
	default y
	depends on ZMK_KSCAN_GPIO_MATRIX_HIZ
	help
	  In a matrix without diodes three keys forming an "L" shape create a
	  conducting path that makes a fourth key read as pressed even though
	  it is not. Such a "ghost" cannot be detected reliably: the sets
	  {W,S,D} and {W,S,D,E} produce exactly the same voltages on all
	  pins, so no digital scan can tell them apart.

	  With this option the driver picks the most plausible interpretation
	  instead of reporting every cell that reads as pressed: a cell that
	  only appeared because a chain of three pressed keys just got
	  completed is dropped, and keys that were already reported as
	  pressed are never dropped.

	  Turn this off to see the raw matrix (ghosts included).

config ZMK_KSCAN_GPIO_MATRIX_HIZ_STUCK_KEY_TIMEOUT_MS
	int "Force-release a key held continuously for this long (ms), 0 to disable"
	default 300000
	depends on ZMK_KSCAN_GPIO_MATRIX_HIZ
	range 0 2147483647
	help
	  A switch that gets mechanically stuck closed keeps its HID key
	  reported forever: it fills the USB/BLE report and repeats
	  characters.

	  With this option the driver reports the key released after it has
	  been continuously held for this many milliseconds and ignores the
	  switch until its contacts actually open again. The check runs on
	  every scan and cannot affect ordinary simultaneous key presses:
	  the threshold is minutes of continuously holding a single key.
	  Set to 0 to disable the protection (for example if a bound action
	  requires holding a key longer than the timeout).
```
